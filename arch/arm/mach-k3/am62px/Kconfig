## arch/arm/mach-k3/am62px/Kconfig
```kconfig
# SPDX-License-Identifier: GPL-2.0+
#
# Copyright (C) 2024 Texas Instruments Incorporated - https://www.ti.com/
#

if SOC_K3_AM62P5

choice
	prompt "TI K3 AM62Px based boards"
	optional

config TARGET_AM62P5_A53_EVM
	bool "TI K3 based AM62P5 EVM running on A53"
	select ARM64
	select BINMAN
	select OF_SYSTEM_SETUP
	imply TI_COMMON_CMD_OPTIONS

config TARGET_AM62P5_R5_EVM
	bool "TI K3 based AM62P5 EVM running on R5"
	select CPU_V7R
	select SYS_THUMB_BUILD
	select K3_LOAD_SYSFW
	select RAM
	select SPL_RAM
	select K3_DDRSS
	select BINMAN
	imply SYS_K3_SPL_ATF

config TARGET_PHYCORE_AM62PX_A53
	bool "PHYTEC phyCORE-AM62Px running on A53"
	select ARM64
	select BINMAN
	select OF_SYSTEM_SETUP

config TARGET_PHYCORE_AM62PX_R5
	bool "PHYTEC phyCORE-AM62Px running on R5"
	select CPU_V7R
	select SYS_THUMB_BUILD
	select K3_LOAD_SYSFW
	select RAM
	select SPL_RAM
	select K3_DDRSS
	select BINMAN
	imply SYS_K3_SPL_ATF

endchoice

source "board/ti/am62px/Kconfig"
source "board/phytec/phycore_am62px/Kconfig"

endif
```

## board/beagle/beaglebadge/Kconfig
```kconfig
# SPDX-License-Identifier:     GPL-2.0+
#
# Copyright (C) 2026 Texas Instruments Incorporated - https://www.ti.com/
#

choice
	prompt "BeagleBoard.org AM62L3 based BeagleBadge board"
	optional

config TARGET_AM62L3_BEAGLEBADGE
	bool "BeagleBoard.org AM62L3 BeagleBadge"
	select ARM64
	select BINMAN
	select OF_UPSTREAM
	select OF_SYSTEM_SETUP

endchoice

if TARGET_AM62L3_BEAGLEBADGE

config SYS_BOARD
       default "beaglebadge"

config SYS_VENDOR
       default "beagle"

config SYS_CONFIG_NAME
       default "beaglebadge"

source "board/ti/common/Kconfig"

endif
```

## board/phytec/am62lx-phyflex-fpsc-g/Kconfig
```kconfig
# SPDX-License-Identifier:     GPL-2.0+
#
# Copyright (C) 2025 PHYTEC Messtechnik GmbH
# Author: Dominik Haller <d.haller@phytec.de>

if TARGET_PHYFLEX_AM62LX

config SYS_BOARD
       default "am62lx-phyflex-fpsc-g"

config SYS_VENDOR
       default "phytec"

config SYS_CONFIG_NAME
       default "am62lx_phyflex_fpsc_g"

config ENV_SOURCE_FILE
       default "am62lx_phyflex_fpsc_g"

source "board/phytec/common/Kconfig"
source "board/phytec/common/k3/Kconfig"

endif
```

## board/phytec/am62px-phyflex-fpsc-g/Kconfig
```kconfig
# SPDX-License-Identifier: GPL-2.0+
#
# Copyright (C) 2026 PHYTEC America LLC - https://www.phytec.com/
#

if TARGET_PHYFLEX_AM62PX_R5 || TARGET_PHYFLEX_AM62PX_A53

config SYS_BOARD
       default "am62px-phyflex-fpsc-g"

config SYS_VENDOR
       default "phytec"

config SYS_CONFIG_NAME
       default "am62px-phyflex-fpsc-g"

source "board/phytec/common/Kconfig"

endif

if TARGET_PHYFLEX_AM62PX_R5

config SPL_LDSCRIPT
	default "arch/arm/mach-omap2/u-boot-spl.lds"

endif
```

## board/phytec/common/k3/Kconfig
```kconfig
config PHYTEC_K3_DDR_PATCH
	bool "Patch DDR timings on PHYTEC K3 SoMs"
	help
	   Allow to override default DDR timings prior to
	   DDRSS driver probing.

config PHYTEC_K3_KEY_BLOB_COPY
	bool "Copy the MPK Key and the degenerate TI key to the build path"
	default y
	help
	   Choose how to handle the keys
	   If PHYTEC_K3_KEY_BLOB_COPY, then copy the keys into the u-boot directory for building
	   This allows for compatibility with the TI dummy keys stored in u-boot.
	   If !PHYTEC_K3_KEY_BLOB_COPY, then use the original key while building
	   It is recommended to use the original key to avoid making copies of keys.

config PHYTEC_K3_MPK_KEY
	string "Path to customer specific MPK key"
	default "custMpk.pem" if PHYTEC_K3_KEY_BLOB_COPY
	default "arch/arm/mach-k3/keys/custMpk.pem" if !PHYTEC_K3_KEY_BLOB_COPY
	help
	   Path to the signing MPK key
	   If PHYTEC_K3_KEY_BLOB_COPY, then path to blob copy of the original key
	   If !PHYTEC_K3_KEY_BLOB_COPY, then path to original key

config PHYTEC_K3_DEGENERATE_KEY
	string "Path to the degenerate TI key"
	default "ti-degenerate-key.pem" if PHYTEC_K3_KEY_BLOB_COPY
	default "arch/arm/mach-k3/keys/ti-degenerate-key.pem" if !PHYTEC_K3_KEY_BLOB_COPY
	help
	   Path to the degenerate key
	   If PHYTEC_K3_KEY_BLOB_COPY, then path to blob copy of the original key
	   If !PHYTEC_K3_KEY_BLOB_COPY, then path to original key

config EMBED_RAUC_ENV
	bool "Embed environment to handle RAUC A/B systems"
	default n
	help
	   Embed RAUC environment variables into u-boot's default environment.
	   Provides logic to select a boot partition based on environment variables
	   and switch to the other if the boot fails.
	   Includes include/env/phytec/rauc.env.
```

## board/phytec/phycore_am62lx/Kconfig
```kconfig
# SPDX-License-Identifier:     GPL-2.0+
#
# Copyright (C) 2025 PHYTEC Messtechnik GmbH
# Author: Dominik Haller <d.haller@phytec.de>

if TARGET_PHYCORE_AM62LX

config SYS_BOARD
       default "phycore_am62lx"

config SYS_VENDOR
       default "phytec"

config SYS_CONFIG_NAME
       default "phycore_am62lx"

source "board/phytec/common/Kconfig"
source "board/phytec/common/k3/Kconfig"

endif
```

## board/phytec/phycore_am62px/Kconfig
```kconfig
# SPDX-License-Identifier: GPL-2.0+
#
# Copyright (C) 2025 PHYTEC America LLC - https://www.phytec.com/
#

if TARGET_PHYCORE_AM62PX_R5 || TARGET_PHYCORE_AM62PX_A53

config SYS_BOARD
       default "phycore_am62px"

config SYS_VENDOR
       default "phytec"

config SYS_CONFIG_NAME
       default "phycore_am62px"

source "board/phytec/common/Kconfig"

endif

if TARGET_PHYCORE_AM62PX_R5

config SPL_LDSCRIPT
	default "arch/arm/mach-omap2/u-boot-spl.lds"

endif
```

## board/phytec/phycore_am67x/Kconfig
```kconfig
# SPDX-License-Identifier: GPL-2.0+
#
# Copyright (C) 2025 PHYTEC America LLC - https://www.phytec.com/
#

if TARGET_PHYCORE_AM67X_R5 || TARGET_PHYCORE_AM67X_A53

config SYS_BOARD
       default "phycore_am67x"

config SYS_VENDOR
       default "phytec"

config SYS_CONFIG_NAME
       default "phycore_am67x"

source "board/phytec/common/Kconfig"

endif

if TARGET_PHYCORE_AM67X_R5

config SPL_LDSCRIPT
	default "arch/arm/mach-omap2/u-boot-spl.lds"

endif
```

## board/phytec/phycore_am68x/Kconfig
```kconfig
#
# Copyright (C) 2023 PHYTEC Messtechnik GmbH
# Author: Dominik Haller <d.haller@phytec.de>
#
# SPDX-License-Identifier:     GPL-2.0+
#

choice
	prompt "PHYTEC phyCORE-AM68x/TDA4x based boards"
	optional

config TARGET_PHYCORE_AM68X_A72
	bool "PHYTEC phyCORE-AM68x (A72 processor)"
	select ARM64
	select SYS_DISABLE_DCACHE_OPS
	select BINMAN

config TARGET_PHYCORE_AM68X_R5
	bool "PHYTEC phyCORE-AM68x (R5 processor)"
	select CPU_V7R
	select SYS_THUMB_BUILD
	select K3_LOAD_SYSFW
	select RAM
	select SPL_RAM
	select K3_DDRSS
	select BINMAN
	imply SYS_K3_SPL_ATF

endchoice

if TARGET_PHYCORE_AM68X_A72

config SYS_BOARD
       default "phycore_am68x"

config SYS_VENDOR
       default "phytec"

config SYS_CONFIG_NAME
       default "phycore_am68x"

source "board/phytec/common/Kconfig"

endif

if TARGET_PHYCORE_AM68X_R5

config SYS_BOARD
       default "phycore_am68x"

config SYS_VENDOR
       default "phytec"

config SYS_CONFIG_NAME
       default "phycore_am68x"

source "board/phytec/common/Kconfig"

endif

config PHYCORE_AM68X_RAM_SIZE_FIX
        bool "Set phyCORE-AM68x RAM size fix instead of detecting"
        default false
        help
          RAM size is automatic being detected with the help of
          the EEPROM introspection data. Set RAM size to a fix value
          instead.

choice
        prompt "phyCORE-AM68x RAM size"
        depends on PHYCORE_AM68X_RAM_SIZE_FIX
        default PHYCORE_AM68X_RAM_SIZE_2X2GB

config PHYCORE_AM68X_RAM_SIZE_1X2GB
	bool "1X2GB RAM"
	help
	   Set RAM size fix to 2GB in 1x2GB configuration for phyCORE-AM68x.

config PHYCORE_AM68X_RAM_SIZE_2X2GB
        bool "2X2GB RAM"
        help
          Set RAM size fix to 4GB in 2x2GB configuration for phyCORE-AM68x.

config PHYCORE_AM68X_RAM_SIZE_2X4GB
        bool "2X4GB RAM"
        help
          Set RAM size fix to 8GB in 2x4GB configuration for phyCORE-AM68x.

endchoice
```

## configs/am62lx_minimal_defconfig
```kconfig
#include <configs/am62lx_evm_defconfig>

CONFIG_DEFAULT_DEVICE_TREE="ti/k3-am62l3-minimal"
CONFIG_USE_PREBOOT=y
CONFIG_PREBOOT="run set_minimal_mem"
```

## configs/am62x_minimal_r5_defconfig
```kconfig
#include <configs/am62x_evm_r5_defconfig>

CONFIG_DEFAULT_DEVICE_TREE="k3-am625-r5-minimal"
```

## configs/phycore_am62x_r5_ethboot_defconfig
```kconfig
#include <configs/phycore_am62x_r5_defconfig>
#include <configs/am62x_r5_ethboot.config>

CONFIG_SPL_STACK_R_ADDR=0x83000000
```

## configs/phycore_am67x_r5_usbdfu_defconfig
```kconfig
#include <configs/phycore_am67x_r5_defconfig>
#include <configs/am62x_r5_usbdfu.config>

CONFIG_ARM=y
CONFIG_ARCH_K3=y
CONFIG_SOC_K3_AM6754=y
CONFIG_TARGET_PHYCORE_AM67X_R5=y

CONFIG_USB_GADGET_MANUFACTURER="PHYTEC"
```

## drivers/video/cadence/Kconfig
```kconfig
# SPDX-License-Identifier: GPL-2.0+

config CDNS_DSI
	bool "Enable Cadence DSI host driver"
	depends on VIDEO
	select MIPI_DPHY_HELPERS
	select VIDEO_MIPI_DSI
	help
	  Enable support for the Cadence MIPI DSI host controller.
	  This driver supports the Cadence DSI IP used on TI K3 SoCs
	  such as J721E and J722S.

config CDNS_DSI_J721E
	bool "Enable Cadence DSI TI J721E platform support"
	depends on CDNS_DSI
	help
	  Enable TI J721E platform-specific wrapper support for the
	  Cadence DSI host controller.

config SPL_CDNS_DSI
	bool "Enable Cadence DSI host driver in SPL"
	depends on SPL_VIDEO
	select MIPI_DPHY_HELPERS
	select SPL_VIDEO_MIPI_DSI
	help
	  Enable support for the Cadence MIPI DSI host controller in SPL.
	  Required for DSI display output during the SPL stage.

config SPL_CDNS_DSI_J721E
	bool "Enable Cadence DSI TI J721E platform support in SPL"
	depends on SPL_CDNS_DSI
	help
	  Enable TI J721E platform-specific wrapper support for the
	  Cadence DSI host controller in SPL.
```
