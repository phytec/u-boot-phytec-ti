// SPDX-License-Identifier: GPL-2.0-only OR MIT
/*
 * phyCORE-AM67x dts file for R5 SPL
 * Copyright (C) 2025 PHYTEC America LLC
 * Author: Nathan Morrisson <nmorrisson@phytec.com>
 */

#include "k3-am6754-phyboard-rigel.dts"
#include "k3-am6754-phyboard-rigel-u-boot.dtsi"

#include "k3-am67-phycore-som-lpddr4-4gb.dtsi"
#include "k3-am62a-ddr.dtsi"
#include "k3-j722s-r5.dtsi"

/* WKUP UART0 is used for DM firmware logs */
&wkup_uart0 {
	status = "okay";
};

&main_bcdma {
	ti,sci = <&dm_tifs>;
	bootph-all;
};

&main_pktdma {
	ti,sci = <&dm_tifs>;
	bootph-all;
};

&phy_gmii_sel{
	bootph-all;
};
