// SPDX-License-Identifier: GPL-2.0
/*
 * Common AM625 MINIMAL dts file for SPLs
 * Copyright (C) 2021-2024 Texas Instruments Incorporated - https://www.ti.com/
 */

#include "k3-am625-sk-binman.dtsi"

/ {
	aliases {
		mmc1 = &sdhci1;
	};
};

#ifdef CONFIG_TARGET_AM625_A53_EVM

#define SPL_AM625_MINIMAL_DTB "spl/dts/ti/k3-am625-minimal.dtb"

&spl_am625_sk_dtb {
	filename = SPL_AM625_MINIMAL_DTB;
};

&spl_am625_sk_dtb_unsigned {
	filename = SPL_AM625_MINIMAL_DTB;
};

#endif
