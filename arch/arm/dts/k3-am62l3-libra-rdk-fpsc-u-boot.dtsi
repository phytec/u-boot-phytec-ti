// SPDX-License-Identifier: GPL-2.0
/*
 * phyCORE-AM62Lx dts file for SPL
 * Copyright (C) 2025 Phytec Messtechnik GmbH
 * Author: Dominik Haller <d.haller@phytec.de>
 *
 */

#include "k3-am62l-phycore-fpsc-binman.dtsi"

/ {
	aliases {
		mmc1 = &sdhci1;
	};
};

&scmi {
	bootph-all;
};
