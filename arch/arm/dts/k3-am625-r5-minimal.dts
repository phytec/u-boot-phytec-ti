// SPDX-License-Identifier: GPL-2.0
/*
 * AM625 MINIMAL dts file for R5 SPL
 * Copyright (C) 2021-2024 Texas Instruments Incorporated - https://www.ti.com/
 */

#include "k3-am625-minimal.dts"
#include "k3-am62x-sk-ddr4-1600MTs.dtsi"
#include "k3-am62-ddr.dtsi"

#include "k3-am625-minimal-u-boot.dtsi"
#include "k3-am625-r5.dtsi"
