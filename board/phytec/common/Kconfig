## board/phytec/common/Kconfig
```kconfig
config PHYTEC_SOM_DETECTION
	bool "Support SoM detection for PHYTEC platforms"
	select SPL_CRC8 if SPL
	help
	   Support of I2C EEPROM based SoM detection.

config PHYTEC_AM62_SOM_DETECTION
	bool "Support SoM detection for AM62 Phytec platforms"
	depends on (TARGET_PHYCORE_AM62X_A53 || TARGET_PHYCORE_AM62X_R5)
	select PHYTEC_SOM_DETECTION
	help
	   Support of I2C EEPROM based SoM detection. Supported
	   for PHYTEC AM62xx boards.

config PHYTEC_AM64_SOM_DETECTION
	bool "Support SoM detection for AM64 Phytec platforms"
	depends on (TARGET_PHYCORE_AM64X_A53 || TARGET_PHYCORE_AM64X_R5)
	select PHYTEC_SOM_DETECTION
	help
	   Support of I2C EEPROM based SoM detection. Supported
	   for PHYTEC AM64xx boards.
```

## board/phytec/phycore_am57x/Kconfig
```kconfig
if TARGET_PHYCORE_AM57X

config SYS_BOARD
	default "phycore_am57x"

config SYS_VENDOR
	default "phytec"

config SYS_CONFIG_NAME
	default "phycore_am57x"

choice
	prompt "Select DDR3L Total Memory Size"
	default PHYCORE_AM57X_256M16_x2_DDR
	help
	  The phyCORE-AM57x SOM can be populated with different DDR3 chips
	  resulting in various configurations and total available memory.
	  By default, memory configuration is read from the SoM's I2C EEPROM.
	  However in case of EEPROM failure this is a fallback config option.

	config PHYCORE_AM57X_128M16_x2_DDR
		bool "512MiB (2x 128M16)"
	config PHYCORE_AM57X_256M16_x2_DDR
		bool "1GiB (2x 256M16)"
	config PHYCORE_AM57X_256M16_x4_DDR
		bool "2GiB (4x 256M16)"
	config PHYCORE_AM57X_512M16_x2_DDR
		bool "2GiB (2x 512M16)"
	config PHYCORE_AM57X_512M16_x2_ECC_DDR
		bool "2GiB (2x 512M16) with ECC"
	config PHYCORE_AM57X_512M16_x4_DDR
		bool "4GiB (4x 512M16)"
endchoice

source "board/phytec/common/Kconfig"
source "board/ti/common/Kconfig"

endif
```

## board/phytec/phycore_am62ax/Kconfig
```kconfig
# SPDX-License-Identifier:     GPL-2.0+
#
# Copyright (C) 2023 PHYTEC America LLC
# Author: Garrett Giordano <ggiordano@phytec.com>

choice
	prompt "PHYTEC phyCORE-AM62Ax based boards"
	optional

config TARGET_PHYCORE_AM62AX_A53
	bool "PHYTEC phyCORE-AM62Ax (A53 processor)"
	select ARM64
	select BINMAN
	select SUPPORT_EXTENSION_SCAN
	imply BOARD
	imply SPL_BOARD

config TARGET_PHYCORE_AM62AX_R5
	bool "PHYTEC phyCORE-AM62a7 (R5 processor)"
	select CPU_V7R
	select SYS_THUMB_BUILD
	select K3_LOAD_SYSFW
	select RAM
	select SPL_RAM
	select K3_DDRSS
	select BINMAN
	imply SYS_K3_SPL_ATF

endchoice

if TARGET_PHYCORE_AM62AX_R5 || TARGET_PHYCORE_AM62AX_A53

config SYS_BOARD
       default "phycore_am62ax"

config SYS_VENDOR
       default "phytec"

config SYS_CONFIG_NAME
       default "phycore_am62ax"

source "board/phytec/common/Kconfig"

endif

if TARGET_PHYCORE_AM62AX_R5

source "board/phytec/common/Kconfig"

endif
```

## board/phytec/phycore_am62x/Kconfig
```kconfig
# SPDX-License-Identifier:     GPL-2.0+
#
# Copyright (C) 2022 - 2023 PHYTEC Messtechnik GmbH
# Author: Wadim Egorov <w.egorov@phytec.de>

choice
	prompt "PHYTEC phyCORE-AM62x based boards"
	optional

config TARGET_PHYCORE_AM62X_A53
	bool "PHYTEC phyCORE-AM62x (A53 processor)"
	select ARM64
	select BINMAN

config TARGET_PHYCORE_AM62X_R5
	bool "PHYTEC phyCORE-AM62x (R5 processor)"
	select CPU_V7R
	select SYS_THUMB_BUILD
	select K3_LOAD_SYSFW
	select RAM
	select SPL_RAM
	select K3_DDRSS
	select BINMAN
	imply SYS_K3_SPL_ATF

endchoice

if TARGET_PHYCORE_AM62X_A53

config SYS_BOARD
       default "phycore_am62x"

config SYS_VENDOR
       default "phytec"

config SYS_CONFIG_NAME
       default "phycore_am62x"

endif

if TARGET_PHYCORE_AM62X_R5

config SYS_BOARD
       default "phycore_am62x"

config SYS_VENDOR
       default "phytec"

config SYS_CONFIG_NAME
       default "phycore_am62x"

endif
```

## board/phytec/phycore_am64x/Kconfig
```kconfig
# SPDX-License-Identifier: GPL-2.0-or-later
#
# Copyright (C) 2021 -2023 PHYTEC Messtechnik GmbH
# Author: Wadim Egorov <w.egorov@phytec.de>

choice
	prompt "PHYTEC phyCORE-AM64x based boards"
	optional

config TARGET_PHYCORE_AM64X_A53
	bool "PHYTEC phyCORE-AM64x (A53 processor)"
	select ARM64
	imply BOARD
	imply SPL_BOARD

config TARGET_PHYCORE_AM64X_R5
	bool "PHYTEC phyCORE-AM64x (R5 processor)"
	select CPU_V7R
	select SYS_THUMB_BUILD
	select K3_LOAD_SYSFW
	select RAM
	select SPL_RAM
	select K3_DDRSS
	imply SYS_K3_SPL_ATF

endchoice

if TARGET_PHYCORE_AM64X_A53

config SYS_BOARD
       default "phycore_am64x"

config SYS_VENDOR
       default "phytec"

config SYS_CONFIG_NAME
       default "phycore_am64x"

endif

if TARGET_PHYCORE_AM64X_R5

config SYS_BOARD
       default "phycore_am64x"

config SYS_VENDOR
       default "phytec"

config SYS_CONFIG_NAME
       default "phycore_am64x"

endif
```

## board/phytec/phycore_am64xx/Kconfig
```kconfig
choice
	prompt "PHYTEC phyCORE-AM64xx based boards"
	optional

config TARGET_PHYCORE_AM64XX_A53
	bool "PHYTEC phyCORE-AM64xx (A53 processor)"
	select ARM64
	select SOC_K3_AM642
	imply BOARD
	imply SPL_BOARD

config TARGET_PHYCORE_AM64XX_R5
	bool "PHYTEC phyCORE-AM64xx (R5 processor)"
	select CPU_V7R
	select SYS_THUMB_BUILD
	select K3_LOAD_SYSFW
	select SOC_K3_AM642
	select RAM
	select SPL_RAM
	select K3_DDRSS
	imply SYS_K3_SPL_ATF

endchoice

if TARGET_PHYCORE_AM64XX_A53

config SYS_BOARD
       default "phycore_am64xx"

config SYS_VENDOR
       default "phytec"

config SYS_CONFIG_NAME
       default "phycore_am64xx"

source "board/ti/common/Kconfig"

endif

if TARGET_PHYCORE_AM64XX_R5

config SYS_BOARD
       default "phycore_am64xx"

config SYS_VENDOR
       default "phytec"

config SYS_CONFIG_NAME
       default "phycore_am64xx"

config SPL_LDSCRIPT
	default "arch/arm/mach-omap2/u-boot-spl.lds"

source "board/ti/common/Kconfig"

endif
```

## configs/am62ax_evm_a53_defconfig
```kconfig
CONFIG_ARM=y
CONFIG_ARCH_K3=y
CONFIG_TI_SECURE_DEVICE=y
CONFIG_TI_COMMON_CMD_OPTIONS=y
CONFIG_SPL_GPIO_SUPPORT=y
CONFIG_SPL_LIBCOMMON_SUPPORT=y
CONFIG_SPL_LIBGENERIC_SUPPORT=y
CONFIG_SYS_MALLOC_F_LEN=0x8000
CONFIG_NR_DRAM_BANKS=2
CONFIG_SOC_K3_AM62A7=y
CONFIG_K3_ATF_LOAD_ADDR=0x9e780000
CONFIG_TARGET_AM62A7_A53_EVM=y
CONFIG_ENV_SIZE=0x20000
CONFIG_ENV_OFFSET=0x680000
CONFIG_DM_GPIO=y
CONFIG_SPL_DM_SPI=y
CONFIG_SPL_TEXT_BASE=0x80080000
CONFIG_SPL_MMC_SUPPORT=y
CONFIG_SPL_SERIAL_SUPPORT=y
CONFIG_SPL_DRIVERS_MISC_SUPPORT=y
CONFIG_SPL_STACK_R_ADDR=0x82000000
CONFIG_SPL_FS_FAT=y
CONFIG_SPL_LIBDISK_SUPPORT=y
CONFIG_SPL_SPI_FLASH_SUPPORT=y
CONFIG_SPL_SPI_SUPPORT=y
CONFIG_DEFAULT_DEVICE_TREE="k3-am62a7-sk"
CONFIG_DISTRO_DEFAULTS=y
# CONFIG_SYS_MALLOC_CLEAR_ON_INIT is not set
CONFIG_FIT_IMAGE_POST_PROCESS=y
CONFIG_SPL_LOAD_FIT=y
CONFIG_SPL_LOAD_FIT_ADDRESS=0x81000000
CONFIG_SPL_LOAD_FIT_APPLY_OVERLAY=y
CONFIG_SPL_FIT_IMAGE_POST_PROCESS=y
CONFIG_BOOTCOMMAND="run findfdt; run envboot; run init_${boot}; run boot_rprocs; if test ${boot_fit} -eq 1; then run get_fit_${boot}; run get_overlaystring; run run_fit; else; run get_kern_${boot}; run get_fdt_${boot}; run get_overlay_${boot}; run run_kern; fi;"
CONFIG_SPL_BOARD_INIT=y
CONFIG_SPL_SYS_MALLOC_SIMPLE=y
CONFIG_SPL_STACK_R=y
CONFIG_SPL_SEPARATE_BSS=y
CONFIG_SYS_MMCSD_RAW_MODE_U_BOOT_USE_SECTOR=y
CONFIG_SYS_MMCSD_RAW_MODE_U_BOOT_SECTOR=0x1400
CONFIG_SPL_ENV_SUPPORT=y
CONFIG_SPL_I2C_SUPPORT=y
CONFIG_SPL_DM_MAILBOX=y
CONFIG_SPL_MTD_SUPPORT=y
CONFIG_SPL_MTD_LOAD=y
CONFIG_SYS_MTD_U_BOOT_OFFS=0x280000
CONFIG_SPL_NAND_SPI_SUPPORT=y
CONFIG_SPL_DM_SPI_FLASH=y
CONFIG_SPL_POWER_SUPPORT=y
CONFIG_SPL_POWER_DOMAIN=y
CONFIG_SPL_RAM_SUPPORT=y
CONFIG_SPL_RAM_DEVICE=y
CONFIG_SPL_THERMAL=y
CONFIG_SPL_USB_GADGET=y
CONFIG_SPL_DFU=y
CONFIG_SPL_YMODEM_SUPPORT=y
# CONFIG_CMD_BOOTZ is not set
# CONFIG_CMD_ASKENV is not set
# CONFIG_CMD_EEPROM is not set
CONFIG_CMD_DM=y
CONFIG_CMD_MTD=y
CONFIG_CMD_REMOTEPROC=y
CONFIG_CMD_USB_MASS_STORAGE=y
# CONFIG_CMD_EXT4_WRITE is not set
CONFIG_CMD_MTDPARTS=y
CONFIG_MTDIDS_DEFAULT="nand0=spi-nand0"
CONFIG_MTDPARTS_DEFAULT="mtdparts=spi-nand0:512k(ospi.tiboot3),2m(ospi.tispl),4m(ospi.u-boot),256k(ospi.env),256k(ospi.env.backup),98048k@32m(ospi.rootfs),256k@130816k(ospi.phypattern)"
CONFIG_CMD_UBI=y
CONFIG_OF_CONTROL=y
CONFIG_SPL_OF_CONTROL=y
CONFIG_SPL_MULTI_DTB_FIT=y
CONFIG_SPL_MULTI_DTB_FIT_NO_COMPRESSION=y
CONFIG_ENV_IS_IN_MMC=y
CONFIG_SYS_MMC_ENV_PART=1
CONFIG_NET_RANDOM_ETHADDR=y
CONFIG_DM=y
CONFIG_SPL_DM=y
CONFIG_SPL_DM_DEVICE_REMOVE=y
CONFIG_SPL_DM_SEQ_ALIAS=y
CONFIG_REGMAP=y
CONFIG_SPL_REGMAP=y
CONFIG_SYSCON=y
CONFIG_SPL_SYSCON=y
CONFIG_SPL_OF_TRANSLATE=y
CONFIG_CLK=y
CONFIG_SPL_CLK=y
CONFIG_CLK_TI_SCI=y
CONFIG_DFU_MMC=y
CONFIG_DFU_RAM=y
CONFIG_DFU_SF=y
CONFIG_DFU_MTD=y
CONFIG_SYS_DFU_DATA_BUF_SIZE=0x40000
CONFIG_SYS_DFU_MAX_FILE_SIZE=0x800000
CONFIG_DMA_CHANNELS=y
CONFIG_TI_K3_NAVSS_UDMA=y
CONFIG_USB_FUNCTION_FASTBOOT=y
CONFIG_FASTBOOT_BUF_ADDR=0xC0000000
CONFIG_FASTBOOT_BUF_SIZE=0x2F000000
CONFIG_TI_SCI_PROTOCOL=y
CONFIG_DA8XX_GPIO=y
CONFIG_DM_PCA953X=y
CONFIG_SPL_DM_PCA953X=y
CONFIG_DM_I2C=y
CONFIG_DM_I2C_GPIO=y
CONFIG_SYS_I2C_OMAP24XX=y
CONFIG_DM_MAILBOX=y
CONFIG_K3_SEC_PROXY=y
CONFIG_DM_MMC=y
CONFIG_SUPPORT_EMMC_BOOT=y
CONFIG_MMC_HS200_SUPPORT=y
CONFIG_SPL_MMC_HS200_SUPPORT=y
CONFIG_MMC_SDHCI=y
CONFIG_MMC_SDHCI_ADMA=y
CONFIG_SPL_MMC_SDHCI_ADMA=y
CONFIG_MMC_SDHCI_AM654=y
CONFIG_MTD=y
CONFIG_DM_MTD=y
CONFIG_MTD_SPI_NAND=y
CONFIG_DM_SPI_FLASH=y
CONFIG_PHY_TI_DP83867=y
CONFIG_PHY_FIXED=y
CONFIG_DM_ETH=y
CONFIG_TI_AM65_CPSW_NUSS=y
CONFIG_PINCTRL=y
CONFIG_SPL_PINCTRL=y
CONFIG_PINCTRL_SINGLE=y
CONFIG_POWER_DOMAIN=y
CONFIG_TI_SCI_POWER_DOMAIN=y
CONFIG_DM_REGULATOR=y
CONFIG_SPL_DM_REGULATOR=y
CONFIG_DM_REGULATOR_FIXED=y
CONFIG_SPL_DM_REGULATOR_FIXED=y
CONFIG_DM_REGULATOR_GPIO=y
CONFIG_SPL_DM_REGULATOR_GPIO=y
CONFIG_K3_SYSTEM_CONTROLLER=y
CONFIG_REMOTEPROC_TI_K3_ARM64=y
CONFIG_REMOTEPROC_TI_K3_DSP=y
CONFIG_REMOTEPROC_TI_K3_R5F=y
CONFIG_DM_RESET=y
CONFIG_RESET_TI_SCI=y
CONFIG_DM_SERIAL=y
CONFIG_SOC_DEVICE=y
CONFIG_SOC_DEVICE_TI_K3=y
CONFIG_SOC_TI=y
CONFIG_SPI=y
CONFIG_DM_SPI=y
CONFIG_CADENCE_QSPI=y
CONFIG_CADENCE_QSPI_PHY=y
CONFIG_SYSRESET=y
CONFIG_SPL_SYSRESET=y
CONFIG_SYSRESET_TI_SCI=y
CONFIG_DM_THERMAL=y
CONFIG_USB=y
CONFIG_DM_USB=y
CONFIG_DM_USB_GADGET=y
CONFIG_SPL_DM_USB_GADGET=y
CONFIG_USB_XHCI_HCD=y
CONFIG_USB_DWC3=y
CONFIG_USB_DWC3_GENERIC=y
CONFIG_USB_GADGET=y
CONFIG_USB_GADGET_MANUFACTURER="Texas Instruments"
CONFIG_USB_GADGET_VENDOR_NUM=0x0451
CONFIG_USB_GADGET_PRODUCT_NUM=0x6165
CONFIG_FS_FAT_MAX_CLUSTSIZE=16384
```

## configs/am62lx_badge_defconfig
```kconfig
#include <configs/am62lx_evm_defconfig>

CONFIG_DEFAULT_DEVICE_TREE="ti/k3-am62l3-badge"
CONFIG_SPI_FLASH_ISSI=y
CONFIG_SPI_FLASH_SPANSION=n
CONFIG_SPI_FLASH_S28HX_T=n
CONFIG_SPI_FLASH_STMICRO=n
CONFIG_SPI_FLASH_MT35XU=n
```

## configs/phycore_am57x_hs_defconfig
```kconfig
CONFIG_ARM=y
CONFIG_ARCH_OMAP2PLUS=y
CONFIG_TI_SECURE_DEVICE=y
CONFIG_TI_COMMON_CMD_OPTIONS=y
CONFIG_SYS_MALLOC_F_LEN=0x2000
CONFIG_NR_DRAM_BANKS=2
CONFIG_PHYTEC_AM57_SOM_DETECTION=y
CONFIG_SYS_MEMTEST_START=0x80000000
CONFIG_SYS_MEMTEST_END=0x90000000
CONFIG_ENV_SIZE=0x40000
CONFIG_ENV_OFFSET=0x200000
CONFIG_DM_GPIO=y
CONFIG_OMAP54XX=y
CONFIG_TI_SECURE_EMIF_REGION_START=0xbdb00000
CONFIG_TI_SECURE_EMIF_TOTAL_REGION_SIZE=0x02000000
CONFIG_TI_SECURE_EMIF_PROTECTED_REGION_SIZE=0x01c00000
CONFIG_TARGET_PHYCORE_AM57X=y
CONFIG_DRA7_DSPEVE_OPP_HIGH=y
CONFIG_DRA7_IVA_OPP_HIGH=y
CONFIG_DRA7_GPU_OPP_HIGH=y
CONFIG_PHYCORE_AM57X_256M16_x4_DDR=y
CONFIG_SPL_DRIVERS_MISC_SUPPORT=y
CONFIG_SPL=y
CONFIG_ENV_OFFSET_REDUND=0x240000
CONFIG_ARMV7_LPAE=y
CONFIG_DEFAULT_DEVICE_TREE="am57xx-phytec-pcm-948"
CONFIG_AHCI=y
CONFIG_DISTRO_DEFAULTS=y
CONFIG_FIT_IMAGE_POST_PROCESS=y
CONFIG_SPL_LOAD_FIT=y
CONFIG_SPL_LOAD_FIT_ADDRESS=0x80200000
CONFIG_SPL_LOAD_FIT_APPLY_OVERLAY=y
CONFIG_SPL_FIT_IMAGE_POST_PROCESS=y
# CONFIG_USE_SPL_FIT_GENERATOR is not set
CONFIG_OF_BOARD_SETUP=y
# CONFIG_USE_BOOTCOMMAND is not set
CONFIG_DEFAULT_FDT_FILE="oftree"
CONFIG_SYS_CONSOLE_INFO_QUIET=y
CONFIG_BOARD_EARLY_INIT_F=y
# CONFIG_MISC_INIT_R is not set
CONFIG_SPL_SYS_MALLOC_SIMPLE=y
CONFIG_SPL_SEPARATE_BSS=y
CONFIG_SPL_DMA=y
CONFIG_CMD_MEMTEST=y
# CONFIG_SPL_NAND_SUPPORT is not set
# CONFIG_CMD_FLASH is not set
CONFIG_CMD_USB_MASS_STORAGE=y
# CONFIG_CMD_SETEXPR is not set
CONFIG_BOOTP_DNS2=y
# CONFIG_CMD_PMIC is not set
CONFIG_OF_CONTROL=y
CONFIG_SPL_OF_CONTROL=y
CONFIG_MULTI_DTB_FIT=y
CONFIG_SPL_MULTI_DTB_FIT=y
CONFIG_SPL_MULTI_DTB_FIT_NO_COMPRESSION=y
CONFIG_ENV_OVERWRITE=y
CONFIG_ENV_IS_IN_MMC=y
CONFIG_SYS_REDUNDAND_ENVIRONMENT=y
CONFIG_SYS_RELOC_GD_ENV_ADDR=y
CONFIG_SYS_MMC_ENV_DEV=1
CONFIG_ENV_VARS_UBOOT_RUNTIME_CONFIG=y
CONFIG_VERSION_VARIABLE=y
CONFIG_BOOTP_SEND_HOSTNAME=y
CONFIG_DM=y
CONFIG_SPL_DM=y
CONFIG_SPL_DM_SEQ_ALIAS=y
CONFIG_SPL_REGMAP=y
CONFIG_SPL_SYSCON=y
CONFIG_SPL_OF_TRANSLATE=y
CONFIG_DWC_AHCI=y
CONFIG_DFU_MMC=y
CONFIG_DFU_RAM=y
CONFIG_USB_FUNCTION_FASTBOOT=y
CONFIG_FASTBOOT_BUF_ADDR=0x82000000
CONFIG_FASTBOOT_BUF_SIZE=0x2F000000
CONFIG_FASTBOOT_USB_DEV=1
CONFIG_FASTBOOT_FLASH=y
CONFIG_FASTBOOT_FLASH_MMC_DEV=1
CONFIG_FASTBOOT_CMD_OEM_FORMAT=y
CONFIG_DM_I2C=y
CONFIG_MISC=y
CONFIG_DM_MMC=y
CONFIG_SUPPORT_EMMC_BOOT=y
CONFIG_MMC_OMAP_HS=y
CONFIG_MTD=y
CONFIG_PHY_MICREL=y
CONFIG_PHY_MICREL_KSZ90X1=y
CONFIG_DM_ETH=y
CONFIG_MII=y
CONFIG_DRIVER_TI_CPSW=y
CONFIG_PIPE3_PHY=y
CONFIG_OMAP_USB2_PHY=y
CONFIG_DM_PMIC=y
CONFIG_PMIC_PALMAS=y
CONFIG_DM_REGULATOR=y
CONFIG_DM_REGULATOR_PALMAS=y
CONFIG_DM_SCSI=y
CONFIG_DM_SERIAL=y
CONFIG_USB=y
CONFIG_DM_USB=y
CONFIG_DM_USB_GADGET=y
CONFIG_SPL_DM_USB_GADGET=y
CONFIG_USB_XHCI_HCD=y
CONFIG_USB_XHCI_DWC3=y
CONFIG_USB_DWC3=y
CONFIG_USB_DWC3_GENERIC=y
CONFIG_USB_GADGET=y
CONFIG_USB_GADGET_MANUFACTURER="Texas Instruments"
CONFIG_USB_GADGET_VENDOR_NUM=0x0451
CONFIG_USB_GADGET_PRODUCT_NUM=0xd022
```
